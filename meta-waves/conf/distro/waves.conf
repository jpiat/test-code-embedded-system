## meta-waves/conf/distro/waves.conf
```bitbake
include conf/distro/poky.conf
DISTRO = "waves"
DISTRO_NAME = "Waves-System"
DISTRO_VERSION = "1.0"
DISTRO_CODENAME = "Agapanthe"
SDK_VENDOR = "-wavessdk"
SDK_VERSION="${DISTRO_VERSION}"
MAINTAINER = "info@wsystem.com"

TARGET_VENDOR = "-waves"

DISTRO_FEATURES:remove = "x11 wayland vulkan directfb opengl"
DISTRO_FEATURES += "alsa"
DISTRO_FEATURES += "bluetooth"
DISTRO_FEATURES += "ipv6"
DISTRO_FEATURES += "usbgadget"
DISTRO_FEATURES += "usbhost"
DISTRO_FEATURES += "smbfs"
DISTRO_FEATURES += "wifi"
DISTRO_FEATURES += "zeroconf"
DISTRO_FEATURES += "pam"
DISTRO_FEATURES += "pulseaudio"
DISTRO_FEATURES += "overlayfs"
DISTRO_FEATURES += " systemd"

DISTRO_FEATURES_BACKFILL_CONSIDERED += "sysvinit"
VIRTUAL-RUNTIME_init_manager = "systemd"
VIRTUAL-RUNTIME_initscripts = "systemd-compat-units"

PACKAGE_CLASSES = "package_ipk"
```

## meta-waves/conf/layer.conf
```bitbake
# We have a conf and classes directory, add to BBPATH
BBPATH .= ":${LAYERDIR}"

# We have recipes-* directories, add to BBFILES
BBFILES += "${LAYERDIR}/recipes-*/*/*.bb \
            ${LAYERDIR}/recipes-*/*/*.bbappend"

BBFILE_COLLECTIONS += "meta-waves"
BBFILE_PATTERN_meta-waves = "^${LAYERDIR}/"
BBFILE_PATTERN_meta-waves = "^${LAYERDIR}/"

LAYERDEPENDS_meta-waves = "core"
LAYERSERIES_COMPAT_meta-waves = "kirkstone"

META_TEST_ROOT = "${LAYERDIR}"
```
